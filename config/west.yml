## config/west.yml
```yaml
manifest:
  remotes:
    - name: zmkfirmware
      url-base: https://github.com/zmkfirmware
    - name: urob
      url-base: https://github.com/urob
  projects:
    - name: zmk
      remote: zmkfirmware
      revision: v0.1
      import: app/west.yml
    - name: zmk-auto-layer
      remote: urob
      revision: v0.1
      path: modules/zmk/zmk-auto-layer
  self:
    path: config
```
